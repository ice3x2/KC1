## zmk/app/boards/shields/kc1/Kconfig.defconfig
```kconfig
if SHIELD_KC1_LEFT

config ZMK_KEYBOARD_NAME
    default "KC1"

config ZMK_SPLIT_ROLE_CENTRAL
    default y

endif

if SHIELD_KC1_LEFT || SHIELD_KC1_RIGHT

config ZMK_SPLIT
    default y

endif
```

## zmk/app/boards/shields/kc1/Kconfig.shield
```kconfig
config SHIELD_KC1_LEFT
    def_bool $(shields_list_contains,kc1_left)

config SHIELD_KC1_RIGHT
    def_bool $(shields_list_contains,kc1_right)
```
